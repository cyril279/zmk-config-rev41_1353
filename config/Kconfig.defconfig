## config/Kconfig.defconfig
```kconfig
# Copyright (c) 2020 The ZMK Contributors
# SPDX-License-Identifier: MIT

if SHIELD_41_1353

config ZMK_KEYBOARD_NAME
    default "41_1353"

endif
```

## config/Kconfig.shield
```kconfig
# Copyright (c) 2020 The ZMK Contributors
# SPDX-License-Identifier: MIT

config SHIELD_41_1353
    def_bool $(shields_list_contains,41_1353)
```

## config/boards/shields/rev1353/Kconfig.defconfig
```kconfig
# Copyright (c) 2020 The ZMK Contributors
# SPDX-License-Identifier: MIT

if SHIELD_REV1353

config ZMK_KEYBOARD_NAME
    default "rev1353"

endif
```

## config/boards/shields/rev1353/Kconfig.shield
```kconfig
# Copyright (c) 2020 The ZMK Contributors
# SPDX-License-Identifier: MIT

config SHIELD_REV1353
    def_bool $(shields_list_contains,rev1353)
```
